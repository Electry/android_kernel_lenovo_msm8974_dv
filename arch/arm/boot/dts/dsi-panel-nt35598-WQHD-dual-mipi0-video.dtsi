/* Copyright (c) 2013, The Linux Foundation. All rights reserved.
 *
 * This program is free software; you can redistribute it and/or modify
 * it under the terms of the GNU General Public License version 2 and
 * only version 2 as published by the Free Software Foundation.
 *
 * This program is distributed in the hope that it will be useful,
 * but WITHOUT ANY WARRANTY; without even the implied warranty of
 * MERCHANTABILITY or FITNESS FOR A PARTICULAR PURPOSE.  See the
 * GNU General Public License for more details.
 */

&mdss_mdp {
		dsi_boe_nt35598_WQHD_vid0: qcom,mdss_dsi_nt35598_WQHD_dual_mipi0_video {
		/*compatible = "qcom,mdss-dsi-panel";*/
		qcom,mdss-dsi-panel-name = "BOE WQHD video mode dsi panel 0";
		qcom,mdss-dsi-panel-controller = <&mdss_dsi0>;
		qcom,mdss-dsi-panel-type = "dsi_video_mode";
		qcom,mdss-dsi-panel-destination = "display_1";
		qcom,mdss-dsi-panel-framerate = <60>;
		qcom,mdss-dsi-virtual-channel-id = <0>;
		qcom,mdss-dsi-stream = <0>;
		qcom,mdss-dsi-panel-width = <720>;
		qcom,mdss-dsi-panel-height = <2560>;
		qcom,mdss-dsi-h-front-porch = <200>;
		qcom,mdss-dsi-h-back-porch = <200>;
		qcom,mdss-dsi-h-pulse-width = <2>;
		qcom,mdss-dsi-h-sync-skew = <0>;
		qcom,mdss-dsi-v-back-porch = <20>;
		qcom,mdss-dsi-v-front-porch = <20>;
		qcom,mdss-dsi-v-pulse-width = <2>;
		qcom,mdss-dsi-h-left-border = <0>;
		qcom,mdss-dsi-h-right-border = <0>;
		qcom,mdss-dsi-v-top-border = <0>;
		qcom,mdss-dsi-v-bottom-border = <0>;
		qcom,mdss-dsi-bpp = <24>;
		qcom,mdss-dsi-color-order = <0>;
		qcom,mdss-dsi-underflow-color = <0xff>;
		qcom,mdss-dsi-border-color = <0>;
		qcom,mdss-dsi-reset-sequence = <1 20>, <0 200>, <1 20>;
		qcom,mdss-dsi-on-command = [
			39 01 00 00 00 00 06 F0 55 AA 52 08 00
			15 01 00 00 00 00 02 B1 21 
			39 01 00 00 00 00 03 B2 87 22
			39 01 00 00 00 00 03 B5 0A 00
			39 01 00 00 00 00 04 B8 00 04 02
			39 01 00 00 00 00 0a B9 01 00 38 00 00 44 12 12 13
			39 01 00 00 00 00 03 BA 00 22
			39 01 00 00 00 00 03 BC 4F 00
			39 01 00 00 00 00 03 C6 11 10
			39 01 00 00 00 00 06 F0 55 AA 52 08 01
			39 01 00 00 00 00 03 B1 10 10
			39 01 00 00 00 00 07 B2 06 12 0A 0A 0A 0A
			39 01 00 00 00 00 07 B3 14 1E 14 1E 14 1E
			39 01 00 00 00 00 07 B6 15 24 17 14 17 14
			39 01 00 00 00 00 03 BC 59 00
			39 01 00 00 00 00 03 BD 59 00
			39 01 00 00 00 00 03 BE 00 FE
			15 01 00 00 00 00 02 CA 0F
			39 01 00 00 00 00 06 F0 55 AA 52 08 02
			39 01 00 00 00 00 0f B0 00 10 25 33 3E 49 52 3B 39 3D 3D 54 64 66
			39 01 00 00 00 00 10 B1 62 78 8F 8F 9F A6 B4 B5 BD C5 D1 DD EC FA FF
			39 01 00 00 00 00 0f B2 00 10 25 33 3E 49 52 3B 39 3D 3D 54 64 66
			39 01 00 00 00 00 10 B3 62 78 8F 8F 9F A6 B4 B5 BD C5 D1 DD EC FA FF
			39 01 00 00 00 00 0f B4 00 10 25 33 3E 49 52 3B 39 3D 3D 54 64 66
			39 01 00 00 00 00 10 B5 62 78 8F 8F 9F A6 B4 B5 BD C5 D1 DD EC FA FF
			39 01 00 00 00 00 0f B6 00 10 25 33 3E 49 52 3B 39 3D 3D 54 64 66
			39 01 00 00 00 00 10 B7 62 78 8F 8F 9F A6 B4 B5 BD C5 D1 DD EC FA FF
			39 01 00 00 00 00 0f B8 00 10 25 33 3E 49 52 3B 39 3D 3D 54 64 66
			39 01 00 00 00 00 10 B9 62 78 8F 8F 9F A6 B4 B5 BD C5 D1 DD EC FA FF
			39 01 00 00 00 00 0f BA 00 10 25 33 3E 49 52 3B 39 3D 3D 54 64 66
			39 01 00 00 00 00 10 BB 62 78 8F 8F 9F A6 B4 B5 BD C5 D1 DD EC FA FF
			39 01 00 00 00 00 06 F0 55 AA 52 08 03
			39 01 00 00 00 00 05 B0 0A 0A 0A 0A
			39 01 00 00 00 00 05 B1 00 00 00 00
			39 01 00 00 00 00 08 B2 00 00 14 00 AA 02 21
			39 01 00 00 00 00 08 B3 00 00 00 00 00 00 00 
			39 01 00 00 00 00 03 B4 00 00
			39 01 00 00 00 00 05 B5 1A 21 06 06
			39 01 00 00 00 00 06 BA 13 00 14 00 AA
			39 01 00 00 00 00 06 BB 13 00 14 00 AA
			39 01 00 00 00 00 06 F0 55 AA 52 08 05
			39 01 00 00 00 00 04 B0 01 11 03
			39 01 00 00 00 00 03 B2 B6 D0
			39 01 00 00 00 00 03 B3 10 33
			39 01 00 00 00 00 02 B4 16
			39 01 00 00 00 00 04 B5 06 50 00
			39 01 00 00 00 00 04 B6 06 50 00
			39 01 00 00 00 00 06 BA 8E 00 00 14 00
			39 01 00 00 00 00 06 BB 06 00 00 14 00
			15 01 00 00 00 00 02 C1 00
			39 01 00 00 00 00 03 C8 02 20
			39 01 00 00 00 00 03 C9 02 20
			39 01 00 00 00 00 06 D0 03 2A 03 00 00 
			39 01 00 00 00 00 06 D1 03 2A 03 00 00 
			39 01 00 00 00 00 02 EC 11
			39 01 00 00 00 00 02 ED 00
			39 01 00 00 00 00 03 EE 03 00
			39 01 00 00 00 00 06 F0 55 AA 52 08 06
			39 01 00 00 00 00 06 B0 22 22 22 07 05
			39 01 00 00 00 00 06 B1 1F 21 01 12 11
			39 01 00 00 00 00 06 B2 22 22 22 22 22
			39 01 00 00 00 00 06 B3 22 1D 1D 1D 1B
			39 01 00 00 00 00 06 B4 1B 1B 19 19 19
			39 01 00 00 00 00 04 B5 22 22 22
			39 01 00 00 00 00 06 B6 22 22 22 06 04
			39 01 00 00 00 00 06 B7 1F 21 00 12 11
			39 01 00 00 00 00 06 B8 22 22 22 22 22
			39 01 00 00 00 00 06 B9 22 1D 1D 1D 1B
			39 01 00 00 00 00 06 BA 1B 1B 19 19 19
			39 01 00 00 00 00 04 BB 22 22 22
			39 01 00 00 00 00 06 C0 22 22 22 04 06
			39 01 00 00 00 00 06 C1 21 1F 00 11 12
			39 01 00 00 00 00 06 C2 22 22 22 22 22
			39 01 00 00 00 00 06 C3 22 1D 1D 1D 1B
			39 01 00 00 00 00 06 C4 1B 1B 19 19 19
			39 01 00 00 00 00 04 C5 22 22 22
			39 01 00 00 00 00 06 C6 22 22 22 05 07
			39 01 00 00 00 00 06 C7 21 1F 01 11 12
			39 01 00 00 00 00 06 C8 22 22 22 22 22
			39 01 00 00 00 00 06 C9 22 1D 1D 1D 1B
			39 01 00 00 00 00 06 CA 1B 1B 19 19 19
			39 01 00 00 00 00 04 CB 22 22 22
			39 01 00 00 00 00 04 D0 00 AA AA
			39 01 00 00 00 00 05 FF AA 55 A5 80
			39 01 00 00 00 00 02 6F 02
			39 01 00 00 00 00 02 F7 67
			39 01 00 00 00 00 02 35 00                           
			05 01 00 00 78 00 01 11
			05 01 00 00 78 00 01 10
			05 01 00 00 78 00 01 11
			05 01 00 00 28 00 01 29];
		qcom,mdss-dsi-off-command = [05 01 00 00 32 00 02 28 00
			05 01 00 00 78 00 02 10 00];
		qcom,mdss-dsi-on-command-state = "dsi_lp_mode";
		qcom,mdss-dsi-off-command-state = "dsi_hs_mode";
		qcom,mdss-dsi-h-sync-pulse = <0>;
		qcom,mdss-dsi-traffic-mode = "non_burst_sync_event";
		qcom,mdss-dsi-lane-map = <0>;
		qcom,mdss-dsi-bllp-eof-power-mode;
		qcom,mdss-dsi-bllp-power-mode;
		qcom,mdss-dsi-lane-0-state;
		qcom,mdss-dsi-lane-1-state;
		qcom,mdss-dsi-lane-2-state;
		qcom,mdss-dsi-lane-3-state;
		qcom,mdss-dsi-panel-timings = [ef 38 25 00 67 70  
			29 3c 2c 03 04 00];
		qcom,mdss-dsi-t-clk-post = <0x20>;
		qcom,mdss-dsi-t-clk-pre = <0x3e>;
		qcom,mdss-dsi-bl-min-level = <1>;
		qcom,mdss-dsi-bl-max-level = <4095>;
		qcom,mdss-dsi-dma-trigger = "trigger_sw";
		qcom,mdss-dsi-mdp-trigger = "none";
		qcom,mdss-dsi-bl-pmic-control-type = "bl_ctrl_pwm";
		qcom,mdss-dsi-bl-pmic-pwm-frequency = <50>;
		qcom,mdss-dsi-bl-pmic-bank-select = <2>;
		qcom,mdss-dsi-pwm-gpio = <&pm8941_gpios 25 0>;
	};
};
