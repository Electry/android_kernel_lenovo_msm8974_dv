## arch/arm/hotplug/Kconfig
```kconfig
config INTELLI_PLUG
        bool "Enable Intelli-Plug cpu hotplug driver"
        default n
        help
          Generic Intelli-plug cpu hotplug driver for ARM SOCs

config ELE_PLUG
        bool "Enable Ele-Plug cpu hotplug driver"
        default y
        help
          Ele-Plug cpu hotplug driver for Symmetric Multiprocessor SoCs.
          YES. Another hotplug. This is the shittiest ever made.
          Developed by Electry.
```

## drivers/input/touchscreen/s3408/Kconfig
```kconfig
config TOUCHSCREEN_SYNAPTICS_DSX_RMI4_I2C
	tristate "Synaptics DSX I2C touchscreen"
	depends on I2C
	help
	  Say Y here if you have a Synaptics DSX I2C touchscreen
	  connected to your system.

	  If unsure, say N.

	  To compile this driver as a module, choose M here: the
	  module will be called synaptics_dsx_i2c.

config TOUCHSCREEN_SYNAPTICS_RMI4_DSX_DEV
	tristate "Synaptics DSX touchscreen char device"
	depends on TOUCHSCREEN_SYNAPTICS_DSX_RMI4_I2C
	help
	  This enables support for direct register access for Synaptics DSX
	  touchscreens.

config TOUCHSCREEN_SYNAPTICS_DSX_RMI4_FW_UPDATE
	tristate "Synaptics DSX touchscreen firmware update"
	depends on TOUCHSCREEN_SYNAPTICS_DSX_RMI4_I2C
	help
	  This enables support for firmware update for Synaptics DSX
	  touchscreens.
```
